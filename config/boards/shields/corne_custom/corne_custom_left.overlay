/*
 * Copyright (c) 2020 Pete Johanson
 *
 * SPDX-License-Identifier: MIT
 */

#include "corne_custom.dtsi"

&kscan0 {
    col-gpios
        = <&pro_micro 21 GPIO_ACTIVE_HIGH>
        , <&pro_micro 20 GPIO_ACTIVE_HIGH>
        , <&pro_micro 19 GPIO_ACTIVE_HIGH>
        , <&pro_micro 18 GPIO_ACTIVE_HIGH>
        , <&pro_micro 15 GPIO_ACTIVE_HIGH>
        , <&pro_micro 14 GPIO_ACTIVE_HIGH>
        ;

};

// vim: filetype=dts fdm=marker:
&kscan0 {
 diode-direction = "row2col";
 row-gpios
 = <&gpio1 0 GPIO_ACTIVE_HIGH>
 , <&gpio0 11 GPIO_ACTIVE_HIGH>
 , <&gpio1 4 GPIO_ACTIVE_HIGH>
 , <&gpio1 6 GPIO_ACTIVE_HIGH>
 ;
 col-gpios
 = <&gpio0 2 (GPIO_ACTIVE_HIGH | GPIO_PULL_DOWN)>
 , <&gpio1 15 (GPIO_ACTIVE_HIGH | GPIO_PULL_DOWN)>
 , <&gpio1 13 (GPIO_ACTIVE_HIGH | GPIO_PULL_DOWN)>
 , <&gpio1 11 (GPIO_ACTIVE_HIGH | GPIO_PULL_DOWN)>
 , <&gpio0 10 (GPIO_ACTIVE_HIGH | GPIO_PULL_DOWN)>
 , <&gpio0 9 (GPIO_ACTIVE_HIGH | GPIO_PULL_DOWN)>
 ;
};

